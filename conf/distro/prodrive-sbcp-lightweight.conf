## conf/distro/prodrive-sbcp-lightweight.conf
```bitbake
# Development distribution configuration for Prodrive Single Board Computer Plus

# Copyright (C) 2023 Prodrive Technologies B.V. - All Rights Reserved
# Unauthorized copying of this file, via any medium is strictly prohibited
# Proprietary and confidential

require conf/distro/poky.conf
require conf/distro/include/ptic-lightweight.inc

# Override compression for faster boot time
IMAGE_FSTYPES = "cpio.gz"

DISTRO = "prodrive-sbcp-lightweight"
DISTRO_NAME = "Prodrive Single Board Computer Plus Lightweight"
DISTROOVERRIDES = "poky:prodrive-sbcp-lightweight"
DISTRO_VERSION = "1.1.0"
```
